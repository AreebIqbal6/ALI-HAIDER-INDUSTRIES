## firmware/ldl-wt32/main/Kconfig.projbuild
```kconfig
menu "Loom Data Logger (LDL)"

    config LDL_ENDPOINT_URL
        string "Ingest endpoint base URL"
        default ""
        help
            Base URL of the backend, e.g. https://example.com. The firmware
            posts to <url>/api/ingest/v1/batch. Leave empty and set it at
            runtime with the console command `set url <value>`. The device
            token is never compiled in: use `set token <value>`.

    config LDL_MACHINE_ID
        string "Default machine id"
        default "PIC-427708"

    config LDL_SNTP_SERVER
        string "Default SNTP server"
        default "pool.ntp.org"

    config LDL_FIRMWARE_VERSION
        string "Firmware version string"
        default "ldl-wt32 0.1.0"

    config LDL_CLASSIFY_PRE_MS
        int "Stop classification window before STRT edge (ms)"
        range 0 5000
        default 300

    config LDL_CLASSIFY_POST_MS
        int "Stop classification window after STRT edge (ms)"
        range 0 10000
        default 1000

    config LDL_FAILED_START_PICKS
        int "A restart that stops within this many picks is a failed start"
        range 0 100
        default 5

    config LDL_DEBOUNCE_MS
        int "Input debounce time (ms)"
        range 1 500
        default 20

    config LDL_STATE_INTERVAL_S
        int "Periodic state message interval (s)"
        default 60

    config LDL_HEALTH_INTERVAL_S
        int "Health message interval (s)"
        default 60

    config LDL_JOURNAL_INTERVAL_MS
        int "Counter journal interval (ms)"
        default 1000
        help
            A record is written at this interval when picks changed, and at
            least every 60 s otherwise (limits flash wear while idle).

    config LDL_DHCP_TIMEOUT_S
        int "Seconds to wait for DHCP before using the static fallback"
        default 10

    config LDL_STATUS_PAGE
        bool "Enable HTTP status page on port 80"
        default y

endmenu
```

## firmware/ldl-wt32/sdkconfig.defaults
```kconfig
# ---- target / flash ----
CONFIG_IDF_TARGET="esp32"
CONFIG_ESPTOOLPY_FLASHSIZE_4MB=y
CONFIG_PARTITION_TABLE_CUSTOM=y
CONFIG_PARTITION_TABLE_CUSTOM_FILENAME="partitions.csv"
CONFIG_PARTITION_TABLE_FILENAME="partitions.csv"
CONFIG_COMPILER_OPTIMIZATION_SIZE=y

# ---- OTA rollback ----
CONFIG_BOOTLOADER_APP_ROLLBACK_ENABLE=y

# ---- watchdogs / brownout ----
CONFIG_ESP_TASK_WDT_EN=y
CONFIG_ESP_TASK_WDT_INIT=y
CONFIG_ESP_TASK_WDT_TIMEOUT_S=30
CONFIG_ESP_TASK_WDT_PANIC=y
CONFIG_ESP_TASK_WDT_CHECK_IDLE_TASK_CPU0=y
CONFIG_ESP_TASK_WDT_CHECK_IDLE_TASK_CPU1=y
CONFIG_ESP_INT_WDT=y
CONFIG_ESP_BROWNOUT_DET=y
CONFIG_ESP_BROWNOUT_DET_LVL_SEL_0=y
CONFIG_ESP_SYSTEM_PANIC_PRINT_REBOOT=y

# ---- Ethernet (LAN8720, RMII clock in on GPIO0) ----
CONFIG_ETH_ENABLED=y
CONFIG_ETH_USE_ESP32_EMAC=y
CONFIG_ETH_PHY_INTERFACE_RMII=y

# ---- ISR safety while flash is busy ----
CONFIG_PCNT_ISR_IRAM_SAFE=y
CONFIG_GPIO_CTRL_FUNC_IN_IRAM=y

# ---- TLS ----
CONFIG_MBEDTLS_CERTIFICATE_BUNDLE=y
CONFIG_MBEDTLS_CERTIFICATE_BUNDLE_DEFAULT_CMN=y
CONFIG_ESP_TLS_INSECURE=n

# ---- tasks / misc ----
CONFIG_FREERTOS_HZ=1000
CONFIG_ESP_MAIN_TASK_STACK_SIZE=6144
CONFIG_HTTPD_MAX_REQ_HDR_LEN=1024
CONFIG_LWIP_LOCAL_HOSTNAME="ldl"
CONFIG_LOG_DEFAULT_LEVEL_INFO=y
CONFIG_ESP_CONSOLE_UART_DEFAULT=y
```
